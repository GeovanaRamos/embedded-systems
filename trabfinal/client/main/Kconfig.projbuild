## trabfinal/client/main/Kconfig.projbuild
```kconfig
menu "Configuração do Wifi e APIs"

    config ESP_WIFI_SSID
        string "WiFi SSID"
        default "ssid"
        help
            Nome da rede Wifi.

    config ESP_WIFI_PASSWORD
        string "Senha do Wifi"
        default "minha_senha"
        help
            Senha do WiFi (WPA or WPA2).

    config ESP_MAXIMUM_RETRY
        int "Número máximo de tentativas de conexão"
        default 5
        help
            Configure o valor máximo de tentativas de conexão.
    
    config WEATHER_API_KEY
        string "Chave do OpenWeather"
        default "123abc"
        help
            Adicione o valor da chave da API do OpenWeather 
    
    config IP_API_KEY
        string "Chave do IPStack"
        default "123abc"
        help
            Adicione o valor da chave da API do IPStack 
    
endmenu
```
